## config/west.yml
```yaml
manifest:
  remotes:
    - name: zmkfirmware
      url-base: https://github.com/zmkfirmware
    - name: proostas
      url-base: https://github.com/proostas
  projects:
    - name: zmk
      remote: zmkfirmware
      revision: v0.2
      import: app/west.yml
    - name: one-zmk-module
      remote: proostas
      revision: main
    - name: zireael-zmk-module
      remote: proostas
      revision: main
    - name: zmk-antecedent-morph
      remote: proostas
      revision: main
  self:
    path: config
```
